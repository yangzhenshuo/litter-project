/*
 * Image.c
 * 图像处理与识别检测
 * Author:杨镇硕
 */
#include "image.h"
#include "math.h"
#include "System.h"
#include "ProjectMath.h"
#include "communicate.h"
#include "SEEKFREE_MT9V03X_CSI.h"

uint8 BinaryImage[IMAGE_H][IMAGE_W];   //存放二值图
uint8 hist_eq_image[IMAGE_H][IMAGE_W]; //存放直方图均衡化图片
uint8 LightImage[IMAGE_H][IMAGE_W];    //光补偿图

static int Ysite = 0, Xsite = 0; // X、Y坐标
static uint8 *PicRaw;            //保存单行图像

BoxDataTypedef BoxData;        //方框信息
PhotoStatusTypedef Photo[120]; //图像状态信息
BoxTypedef Box;                //方框的长宽
DotTypedef Dot[20];            //存放点的x，y坐标
uint16 Num = 0;                //目标点的数量
uint8 LightModeBuff[120][188] = {
    {49, 48, 47, 46, 45, 44, 43, 42, 41, 40, 40, 39, 38,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 49, 50},
    {49, 48, 47, 46, 45, 44, 43, 42, 41, 40, 39, 38, 37,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 49, 50},
    {48, 47, 46, 45, 44, 43, 42, 41, 40, 39, 38, 38, 37,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 48, 49},
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    {51, 51, 51, 51, 51, 51, 51, 50, 49, 48, 47, 46, 45,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 51, 51},
};
rt_event_t event1;

/***********************************************************
 * @brief 二值化更新线程的入口函数
 * @param
 * @return
 ***********************************************************/
void Binary_entry()
{
  rt_thread_mdelay(10); // 延时等待finsh初始化完毕
  rt_uint32_t e;
  char test[] = "Binary\n";
  while (1)
  {
    seekfree_wireless_send_buff((uint8 *)test, sizeof(test) - 1);
    if (rt_event_recv(event1, ((1) | (2)),
                      RT_EVENT_FLAG_OR | RT_EVENT_FLAG_CLEAR,
                      RT_WAITING_FOREVER, &e) == RT_EOK)
    {
      SystemSettings.Binary_start = 'T';
    }
  }
}
/***********************************************************
 * @brief 摄像头图线显示线程初始化
 * @param
 * @return
 ***********************************************************/
void BinaryRenew_thread_init()
{
  rt_thread_t binary;
  binary = rt_thread_create("binary",     //线程名称
                            Binary_entry, //线程入口函数
                            RT_NULL,      //线程入口参数
                            1024,         //线程栈大小1024字节
                            12,           //线程优先级
                            3);           //线程时间片，同优先级线程起作用
  //创造事件
  event1 = rt_event_create("event1", RT_IPC_FLAG_FIFO);

  //启动线程
  if (RT_NULL != binary)
  {
    rt_thread_startup(binary);
  }
}
/***********************************************************
 * @brief 原图光补偿操作
 * @attation 应首先获得光补偿模型
 ***********************************************************/
void Image_Compensate(uint8 *RawImagePtr, uint8 *LightImagePtr)
{
  uint16 buff;
  for (uint8 i = 0; i < IMAGE_H; i++)
  {
    for (uint8 j = 0; j < IMAGE_W; j++)
    {
      buff = *(RawImagePtr + i * IMAGE_W + j) + LightModeBuff[i][j];
      *(LightImagePtr + i * IMAGE_W + j) = (uint8)((buff > 255) ? 255 : buff); //防止溢出
    }
  }
}
/***********************************************************
 * @brief 大津算法
 * @param image 图像地址
 * @param col 图像宽度（范围1~IMAGE_W）
 * @param row 图像高度（范围1~IMAGE_H）
 * @return 阈值
 ***********************************************************/
static inline uint8 OtsuThreshold(uint8 *image, uint16 col, uint16 row)
{
#define GrayScale 256
#define StartGray 90
  uint16 width = col;
  uint16 height = row;
  int pixelCount[GrayScale]; //每个灰度级的像素个数
  float pixelPro[GrayScale]; //每个灰度级的像素概率
  int16 i, j, pixelSum = width * height;
  uint8 threshold = 0;
  uint8 *data = image; //指向像素数据的指针
  for (i = 0; i < GrayScale; i++)
  {
    pixelCount[i] = 0;
    pixelPro[i] = 0.0;
  }
  //统计灰度级中每个像素在整幅图像中的个数
  int grayTmp = 0;
  uint32 graySum = 0; //灰度值和
  for (i = 0; i < height; i += 2)
  {
    for (j = 0; j < width; j += 2)
    {
      grayTmp = (int)data[i * IMAGE_W + j];
      pixelCount[grayTmp]++; //将像素值作为计数数组的下标
      graySum += grayTmp;    //计算图片总灰度值和
    }
  }
  float grayEverage = (float)graySum / pixelSum; //计算图像平均灰度

  //计算每个像素在整幅图像中的比例
  for (i = 0; i < GrayScale / 2; i++)
  {
    pixelPro[i] = (float)pixelCount[i] / pixelSum;
  }

  //遍历灰度级[0,255]
  float w0, w1, u0tmp, u1tmp, u0, u1, deltaTmp, deltaMax = 0;
  w1 = u1tmp = 0;
  for (i = GrayScale - 1; i >= StartGray; i--) // i作为阈值，从后往前算前景
  {
    w0 += pixelPro[i];        //背景部分每个灰度值的像素点所占比列之和，即背景部分的比例
    u0tmp += i * pixelPro[i]; //背景部分，每个灰度值点的比例*灰度值

    w1 = 1 - w0; //背景
    u1tmp = grayEverage - u1tmp;

    u0 = u0tmp / w0; //背景平均灰度
    u1 = u1tmp / w1; //前景平均灰度

    deltaTmp = w0 * w1 * pow((u0 - u1), 2); //计算方差
    if (deltaTmp > deltaMax)
    {
      deltaMax = deltaTmp;
      threshold = i;
    }
  }
  return threshold;
}
/***********************************************************
 * @brief 大津算法，可对图像特定区域计算阈值
 * @param image 图像地址
 * @param Startwidth 起始图像宽度（范围1~IMAGE_W）
 * @param EndWidth 终止图像宽度（范围1~IMAGE_W）
 * @param StartHeight 起始图像高度（范围1~IMAGE_H）
 * @param EndHeight 终止图像高度（范围1~IMAGE_H）
 * @return 阈值
 ***********************************************************/
static inline uint8 Otsu_threshold(uint8 *image, uint16 StartWidth, uint16 EndWidth, uint16 StartHeight, uint16 EndHeight)
{
#define GrayScale 256
#define StartGray 90
  int pixelCount[GrayScale] = {0};   //像素个数
  float pixelPro[GrayScale] = {0.0}; //像素概率
  int i, j, pixelSum = (EndWidth - StartWidth + 1) * (EndHeight - StartHeight + 1);
  uint8 threshold = 0;
  uint8 *data = image; //指向像素数据的指针
  uint32 graySum = 0;  //灰度值和

  //统计灰度级中每个像素在整幅图像中的个数
  int grayTmp = 0;
  for (i = StartHeight - 1; i < EndHeight; i++)
  {
    for (j = StartWidth - 1; j < EndWidth; j++)
    {
      grayTmp = (int)data[i * IMAGE_W + j];
      pixelCount[grayTmp]++; //将像素值作为计数数组的下标
      graySum += grayTmp;    //计算图片总灰度值和
    }
  }
  float grayEverage = (float)graySum / pixelSum; //计算图像平均灰度

  //计算每个像素在整幅图像中的比例
  for (i = 0; i < GrayScale; i++)
  {
    pixelPro[i] = (float)pixelCount[i] / pixelSum;
  }

  //遍历灰度级[0,255]
  float w0, w1, u0tmp, u1tmp, u0, u1, deltaTmp, deltaMax = 0;
  w1 = u1tmp = 0;
  for (i = GrayScale - 1; i >= StartGray; i--) // i作为阈值，从后往前算前景
  {
    w1 += pixelPro[i]; //前景
    u1tmp += i * pixelPro[i];

    w0 = 1 - w1; //背景
    u0tmp = grayEverage - u1tmp;

    u0 = u0tmp / w0;                        //背景平均灰度
    u1 = u1tmp / w1;                        //前景平均灰度
    deltaTmp = w0 * w1 * pow((u0 - u1), 2); //计算方差
    if (deltaTmp > deltaMax)
    {
      deltaMax = deltaTmp;
      threshold = i;
    }
  }

  return threshold;
}
/***********************************************************
 * @brief 迭代法求阈值
 * @param image 图像地址
 * @param col 图像宽度（范围1~IMAGE_W）
 * @param row 图像高度（范围1~IMAGE_H）
 * @return 阈值
 ***********************************************************/
#define ERROR 2 //误差

int16 EdgeThres = 18; //晚上20  白天25 18

float Iteration_Threshould(uint8 *image, uint16 col_w, uint16 row_h)
{
  uint16_t i = 0, j = 0, N0 = 0, N1 = 0, flag = 0;
  float T0, T1, T2, T_center;
  uint32_t S0 = 0, S1 = 0;
  //初始预估值
  float threshold = 70.0;
  T2 = threshold;

  uint8 *data = image; //指向像素数据的指针
  do
  {
    //分割图像为两部分
    for (i = 0; i < row_h; i++)
    {
      for (j = 0; j < col_w; j++)
      {
        if (image[i * col_w + j] < T2)
        {
          S0 += data[i * col_w + j]; // G2部分的像素灰度值之和
          N0++;                      // G2部分的像素点个数
        }
        else
        {
          S1 += data[i * col_w + j]; // G1部分的像素灰度值之和
          N1++;                      // G1部分的像素点个数
        }
      }
    }
    T0 = S0 / N0;             // G2部分的平均灰度值
    T1 = S1 / N1;             // G1部分的平均灰度值
    T_center = (T0 + T1) / 2; //新的阈值
    if (T2 < T_center)
    {
      if ((T_center - T2) > ERROR)
      {
        flag = 1;
      }
      else
      {
        flag = 0;
      }
    }
    else
    {
      if ((T2 - T_center) > ERROR)
      {
        flag = 1;
      }
      else
      {
        flag = 0;
      }
    }
    T2 = T_center;
    threshold = T2;
  } while (flag);
  return threshold;
}
/***********************************************************
 * @brief 图像直方图均衡化（效果不佳）
 ***********************************************************/
void HistEqImageConvert(uint8 *RawImagePtr, uint8 *HistEqImagePtr)
{
  int gray[256] = {0};                //记录每个灰度级别下的像素个数
  float gray_prob[256] = {0};         //记录灰度分布频率
  float gray_distribution[256] = {0}; //记录原始图像的累计密度
  int gray_equal[256] = {0};          //均衡化后的灰度值
  int gray_sum = 0;                   //像素总数
  gray_sum = IMAGE_H * IMAGE_W;

  //统计每个灰度下的像素个数
  for (int i = 0; i < gray_sum; i++)
  {
    gray[RawImagePtr[i]]++;
  }

  //统计原始图像的灰度分布频率
  for (int i = 0; i < 256; i++)
  {
    gray_prob[i] = (float)gray[i] / gray_sum;
  }
  //计算累计密度
  gray_distribution[0] = gray_prob[0];
  for (int i = 1; i < 256; i++)
  {
    gray_distribution[i] = gray_distribution[i - 1] + gray_prob[i];
  }
  //重新计算均衡化后的灰度值，四舍五入。参考公式：(N-1)*T+0.5
  for (int i = 0; i < 256; i++)
  {
    gray_equal[i] = (uint8)(255 * gray_distribution[i] + 0.5); //(int)(a+0.5)
  }
  //直方图均衡化,更新原图每个点的像素值
  for (int i = 0; i < gray_sum; i++)
  {
    HistEqImagePtr[i] = gray_equal[RawImagePtr[i]];
  }
}
/***********************************************************
 * @brief 求取二值化阈值
 * @param type 0:大津法；1：迭代法；2：阳光算法;3:直方图均衡加大津
 * @param raw_iamge 原始图像起始行地址
 * @return
 ***********************************************************/
static inline void Binary_threshold(uint8 type, uint8 *raw_image)
{
  if (type == 0)
  {
    CarInfo.BinaryThreshold = Otsu_threshold(raw_image, 1, IMAGE_W, 25, IMAGE_H - 10);
  }
  if (type == 1)
  {
    CarInfo.BinaryThreshold = Iteration_Threshould(raw_image, IMAGE_W, IMAGE_H);
  }
  if (type == 2)
  {
    uint8 ImageThreshold1 = Otsu_threshold(raw_image, 1, IMAGE_W, 25, IMAGE_H - 10); //计算第一次阈值
    for (int i = 0; i < IMAGE_H; i++)
      for (int j = 0; j < IMAGE_W; j++)
      {
        if (mt9v03x_csi_image[i][j] > ImageThreshold1)
        {
          BinaryImage[i][j] = mt9v03x_csi_image[i][j];
        }
        else
        {
          BinaryImage[i][j] = ImageThreshold1 - 10;
        }
      }
    uint8 ImageThreshold2 = Otsu_threshold(BinaryImage[0], 1, IMAGE_W, 25, IMAGE_H - 10); //计算第二次阈值
    CarInfo.BinaryThreshold = ImageThreshold2;
  }
  if (type == 3)
  {
    uint8 *HistImagePtr = hist_eq_image[0];
    HistEqImageConvert(raw_image, HistImagePtr);
    CarInfo.BinaryThreshold = Otsu_threshold(HistImagePtr, 1, IMAGE_W, 25, IMAGE_H - 10);
  }
}
/***********************************************************
 * @brief 二值化更新
 * @param type 二值化方法
 * @return
 ***********************************************************/
void Binary_renew(uint8 type)
{
  Image_Compensate(mt9v03x_csi_image[0], LightImage[0]); //光补偿
  Binary_threshold(type, LightImage[0]);
}
/***********************************************************
 * @brief 二值化图像
 * @param
 * @return
 ***********************************************************/
void Binary_image(void)
{
  for (int i = 0; i < IMAGE_H; i++)
    for (int j = 0; j < IMAGE_W; j++)
    {
      if (mt9v03x_csi_image[i][j] > CarInfo.BinaryThreshold)
      {
        BinaryImage[i][j] = White;
      }
      else
      {
        BinaryImage[i][j] = Black;
      }
    }
}
/***********************************************************
 * @brief 描方框四边的线;寻找矩形左下点和右上点来求框的四点坐标
 * @return
 ***********************************************************/
void Scan_line(void)
{
  for (Ysite = 119; Ysite >= 60; Ysite--) //从左到右找从上到下，找边框
  {
    PicRaw = BinaryImage[Ysite];
    if (*(PicRaw + CENTER_POINT) == Black) //寻找左下点
    {
      //寻找底边的最近点
      for (int i = 1; i < 60; i++)
      {
        PicRaw = BinaryImage[Ysite - i];
        if (*(PicRaw + CENTER_POINT) == White)
        {
          Ysite = Ysite - i + 1;
          break;
        }
      }
      for (Xsite = CENTER_POINT; Xsite > 0; Xsite--) //找左右边线
      {
        if (*(PicRaw + CENTER_POINT - Xsite) == Black) //一旦找到左下点就break
        {
          //寻找左边的最近点
          for (int j = 1; j < 60; j++)
          {
            if (*(PicRaw + CENTER_POINT - Xsite + j) == White)
            {
              Xsite = CENTER_POINT - Xsite + j - 1;
              break;
            }
          }
          break;
        }
      }
      BoxData.LeftBorder = Xsite;
      BoxData.HighBorder = Ysite;
      break;
    }
  }
  for (Ysite = 0; Ysite < 60; Ysite++)
  {
    PicRaw = BinaryImage[Ysite];
    if (*(PicRaw + CENTER_POINT) == Black) //如果底边图像中点为黑，寻找右上点
    {
      //寻找顶边的最近点
      for (int i = 1; i < 60; i++)
      {
        PicRaw = BinaryImage[Ysite + i];
        if (*(PicRaw + CENTER_POINT) == White)
        {
          Ysite = Ysite + i - 1;
          break;
        }
      }
      for (Xsite = 0; Xsite < CENTER_POINT; Xsite--) //找左右边线
      {
        if (*(PicRaw + CENTER_POINT + Xsite) == Black)
          break;
      }
      BoxData.RightBorder = CENTER_POINT + Xsite;
      BoxData.LowBorder = Ysite;
      break;
    }
  }
  Box.High = BoxData.HighBorder - BoxData.LowBorder;
  Box.Wide = BoxData.RightBorder - BoxData.LeftBorder;
}
/***********************************************************
 * @brief 寻找目标点并且变换坐标且给出任意两点的距离
 * @return
 ***********************************************************/
void Found_dot_info()
{
  float k0 = 0.0, k1 = 0.0; //变换系数；k0为高的变换系数，k1为宽的变换系数
  Scan_line();
  k0 = 500 / Box.High; // 500和700分别为实际场地的长宽
  k1 = 700 / Box.Wide;
  for (int i = BoxData.LeftBorder + 1; i < BoxData.RightBorder; i++)
    for (int j = BoxData.LowBorder + 1; j < BoxData.HighBorder; j++)
    {
      if (BinaryImage[j][i] == Black && BinaryImage[j][i + 1] == Black)
      {
        Dot[Num].x = i;
        Dot[Num].y = j;
        Num++;
      }
    }
  for (int i = 0; i < Num; i++)
  {
    Dot[i].x = (int)(Dot[i].x - BoxData.LeftBorder) * k1 / 20;
    Dot[i].y = (int)(BoxData.HighBorder - Dot[i].y) * k0 / 20;
  }
}
/***********************************************************
 * @brief 大描线
 ***********************************************************/
uint8 test4[] = "start\n";
// uint8 test2[] = "find dot\n";
static inline void big_scan(void)
{
  for (Ysite = 119; Ysite >= 0; Ysite--)
  {
    PicRaw = BinaryImage[Ysite];
    if (*(PicRaw + CENTER_POINT) == White) //图像中心点为白
    {
      for (Xsite = 0; Xsite < CENTER_POINT; Xsite++) //找左右边线
      {
        if (*(PicRaw + CENTER_POINT - Xsite) == Black) //找到左右线
          break;
        if (*(PicRaw + CENTER_POINT + Xsite) == Black)
          break;
      }
      if (*(PicRaw + CENTER_POINT - Xsite) == Black) //车在图片左边的话
      {
        Photo[Ysite].left = CENTER_POINT - Xsite; //图片左边界点
        for (Xsite = Photo[Ysite].left; Xsite < 186; Xsite++)
        {
          if (*(PicRaw + Xsite) == Black && *(PicRaw + Xsite + 1) == Black)
          {
            Photo[Ysite].right = Xsite;
            break;
          }
          else if (Xsite == 186)
          {
            Photo[Ysite].right = 187;
            break;
          }
        }
        Photo[Ysite].Isdot = 1;
      }
      else if (*(PicRaw + CENTER_POINT + Xsite) == Black) //车在图片左边的话
      {
        Photo[Ysite].right = CENTER_POINT + Xsite; //图片左边界点
        for (Xsite = Photo[Ysite].right; Xsite > 1; Xsite--)
        {
          if (*(PicRaw + Xsite) == Black && *(PicRaw + Xsite - 1) == Black)
          {
            Photo[Ysite].left = Xsite;
            break;
          }
          else if (Xsite == 1)
          {
            Photo[Ysite].left = 0;
            break;
          }
        }
        Photo[Ysite].Isdot = 1;
      }

      Photo[Ysite].center = (Photo[Ysite].left + Photo[Ysite].right) / 2;
    }
    else if (*(PicRaw + CENTER_POINT) == Black) //图像中点为黑
    {
      for (Xsite = 0; Xsite < CENTER_POINT; Xsite++) //找左右边线
      {
        if (*(PicRaw + CENTER_POINT - Xsite) == White) //找到左右线
          break;
        if (*(PicRaw + CENTER_POINT + Xsite) == White)
          break;
      }
      if (*(PicRaw + CENTER_POINT - Xsite) == White && *(PicRaw + CENTER_POINT - Xsite - 2) == White) //车在图片右边的话
      {
        Photo[Ysite].right = CENTER_POINT - Xsite; //图片右边界点
        for (Xsite = Photo[Ysite].right; Xsite > 1; Xsite--)
        {
          if (*(PicRaw + Xsite) == Black && *(PicRaw + Xsite - 1) == Black)
          {
            Photo[Ysite].right = Xsite;
            break;
          }
          else if (Xsite == 1)
          {
            Photo[Ysite].right = 0;
            break;
          }
        }
        Photo[Ysite].Isdot = 1;
      }
      else if (*(PicRaw + CENTER_POINT + Xsite) == White && *(PicRaw + CENTER_POINT + Xsite + 2) == White) //车在图片左边的话
      {
        Photo[Ysite].left = CENTER_POINT + Xsite; //图片左边界点
        for (Xsite = Photo[Ysite].left; Xsite < 186; Xsite++)
        {
          if (*(PicRaw + Xsite) == Black && *(PicRaw + Xsite + 1) == Black)
          {
            Photo[Ysite].right = Xsite;
            break;
          }
          else if (Xsite == 186)
          {
            Photo[Ysite].right = 187;
            break;
          }
        }
        Photo[Ysite].Isdot = 1;
      }
      Photo[Ysite].center = (Photo[Ysite].left + Photo[Ysite].right) / 2;
    }
    //    if (Photo[Ysite].Isdot == 0 && Xsite == CENTER_POINT)
    //      break;
  }
  seekfree_wireless_send_buff((uint8 *)test4, sizeof(test4) - 1);
}
/*************************************************************
 * @brief 寻找定点
 *
 * @return 带回定点的信息
 *************************************************************/
uint8 angle_dot[2]; //顶角信息

void find_top_angle()
{
  int Flag = 0;   //找到顶点标志
  uint8 *row_pic; //保存单行图片
  int j, i;
  for (j = 119; j > 0; j--)
  {
    row_pic = BinaryImage[j];
    for (i = 1; i < 187; i++)
    {
      if (*(row_pic + i) == White && *(row_pic + i - 1) == Black) //找到顶点(黑白)
      {
        angle_dot[0] = i; //顶点横坐标
        angle_dot[1] = j; //顶点纵坐标
        Flag = 1;
        break;
      }
    }
    if (Flag == 1)
    {
      break;
    }
  }
}
/*************************************************************
 * @brief 寻找底边中点
 *
 * @return 带回底边中点信息
 *************************************************************/
uint8 midpoint[2]; //中点信息
void find_midpoint()
{
  int i,j;
  int flag = 0; //找到底边标志位
  //int flag1 = 0;
  //寻找底边
  for (j = 119; j > 0; j--)
  {
    for (i = 1; i < 187; i++)
    {
      if (BinaryImage[j][i - 1] == Black && BinaryImage[j][i] == White && BinaryImage[j][i + 1] == White) //判断找到底边
      {
        midpoint[1] = j; //简单滤波
				midpoint[0] = i;
        flag = 1;
        break;
      }
    }
    if (flag == 1)
    {
      break;
    }
  }
  
//  int n = 0;
//  midpoint[0] = 0;
//  midpoint[1] = 0;
//  big_scan();
//  for (int i = 119; i > 0; i--)
//  {
//    if (Photo[i].center != 0)
//    {
//      midpoint[1] = i;
//      break;
//    }
//  }
//  for (int j = 119; j > 0; j--)
//  {
//    if (Photo[j].center != 0)
//    {
//      midpoint[0] += Photo[j].center;
//      n++;
//    }
//  }
//  midpoint[0] /= n;
}
/*************************************************************
 * @brief 计算当前车与图片存在的角度
 *
 * @return 计算最小角度
 *************************************************************/
uint8 Left_border[20][2];  //左边信息
uint8 Right_border[20][2]; //右边信息

void Computing_angle()
{
  int i, j;
  double left_angle;  //左边夹角
  double right_angle; //右边夹角
  uint8 *row_pic;     //保存单行图片
  //找顶点
  find_top_angle();
  //找图像左边（从顶点向左）
  int left_flag = 0;
  for (j = angle_dot[1]; j > 0; j--)
  {
    row_pic = BinaryImage[j];
    for (i = angle_dot[0]; i >= 0; i--)
    {
      if (*(row_pic + i) == White && *(row_pic + i - 1) == Black && *(row_pic + i - 2) == Black) //找到边界点(白黑黑)
      {
        Left_border[left_flag][0] = i; //横坐标
        Left_border[left_flag][1] = j;
        left_flag++;
        break;
      }
    }
    if (left_flag > 20)
      break;
  }
  //找图像右边（从顶点向右）
  int right_flag = 0;
  for (j = angle_dot[1]; j > 0; j--)
  {
    row_pic = BinaryImage[j];
    for (i = angle_dot[0]; i < 188; i++)
    {
      if (*(row_pic + i) == White && *(row_pic + i + 1) == Black && *(row_pic + i + 2) == Black) //找到边界点(白黑黑)
      {
        Right_border[right_flag][0] = i; //横坐标
        Right_border[right_flag][1] = j;
        right_flag++;
        break;
      }
    }
    if (right_flag > 20)
      break;
  }
  //计算左右两边的角度大小
  left_angle = atan2(angle_dot[1] - Left_border[10][1], angle_dot[0] - Left_border[10][0]) * 180 / 3.14;
  right_angle = atan2(angle_dot[1] - Right_border[10][1], Right_border[10][0] - angle_dot[0]) * 180 / 3.14;
  if (left_angle > right_angle)
    CarInfo.current_angle = right_angle;
  else
    CarInfo.current_angle = left_angle;
}