/*
 * Image.c
 * 图像处理与识别检测
 * Author:杨镇硕
 */
#include "image.h"
#include "math.h"
#include "System.h"
#include "ProjectMath.h"
#include "communicate.h"
#include "SEEKFREE_MT9V03X_CSI.h"

#define PV PixelValue

uint8 BinaryImage[IMAGE_H][IMAGE_W];   //存放二值图
uint8 hist_eq_image[IMAGE_H][IMAGE_W]; //存放直方图均衡化图片
uint8 LightImage[IMAGE_H][IMAGE_W];    //光补偿图
uint8 erode_image[IMAGE_H][IMAGE_W];   //腐蚀后的图
uint8 dilate_image[IMAGE_H][IMAGE_W];  //膨胀后的图

static int Ysite = 0, Xsite = 0; // X、Y坐标
static uint8 *PicRaw;            //保存单行图像

BoxDataTypedef BoxData;         //方框信息
BoxTypedef Box;                 //方框的长宽
uint16 Num = 0;                 //目标点的数量
uint8 LightModeBuff[120][188] = {
    {49, 48, 47, 46, 45, 44, 43, 42, 41, 40, 40, 39, 38,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 49, 50},
    {49, 48, 47, 46, 45, 44, 43, 42, 41, 40, 39, 38, 37,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 49, 50},
    {48, 47, 46, 45, 44, 43, 42, 41, 40, 39, 38, 38, 37,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 48, 49},
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    {51, 51, 51, 51, 51, 51, 51, 50, 49, 48, 47, 46, 45,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 51, 51},
};
/***********************************************************
 * @brief 二值化更新线程的入口函数
 * @param
 * @return
 ***********************************************************/
void Binary_entry()
{
  rt_thread_mdelay(10); // 延时等待finsh初始化完毕
  rt_uint32_t e;
  while (1)
  {
		rt_sem_take(key1_sem, RT_WAITING_FOREVER);
		if (CarInfo.BinaryMethod < 3 && CarInfo.BinaryMethod >= 0)
    {
      CarInfo.BinaryMethod++;
    }
    else
    {
      CarInfo.BinaryMethod = 0;
    }
		SystemSettings.Binary_start = 'T';
  }
}
/***********************************************************
 * @brief 摄像头图线显示线程初始化
 * @param
 * @return
 ***********************************************************/
void BinaryRenew_thread_init()
{
  rt_thread_t binary;
  binary = rt_thread_create("binary",     //线程名称
                            Binary_entry, //线程入口函数
                            RT_NULL,      //线程入口参数
                            1024,         //线程栈大小1024字节
                            12,           //线程优先级
                            3);          //线程时间片，同优先级线程起作用
  
  //启动线程
  if (RT_NULL != binary)
  {
    rt_thread_startup(binary);
  }
}
/***********************************************************
 * @brief 原图光补偿操作
 * @attation 应首先获得光补偿模型
 ***********************************************************/
void Image_Compensate(uint8 *RawImagePtr, uint8 *LightImagePtr)
{
  uint16 buff;
  for (uint8 i = 0; i < IMAGE_H; i++)
  {
    for (uint8 j = 0; j < IMAGE_W; j++)
    {
      buff = *(RawImagePtr + i * IMAGE_W + j) + LightModeBuff[i][j];
      *(LightImagePtr + i * IMAGE_W + j) = (uint8)((buff > 255) ? 255 : buff); //防止溢出
    }
  }
}
/***********************************************************
 * @brief 大津算法
 * @param image 图像地址
 * @param col 图像宽度（范围1~IMAGE_W）
 * @param row 图像高度（范围1~IMAGE_H）
 * @return 阈值
 ***********************************************************/
static inline uint8 OtsuThreshold(uint8 *image, uint16 col, uint16 row)
{
#define GrayScale 256
#define StartGray 90
  uint16 width = col;
  uint16 height = row;
  int pixelCount[GrayScale]; //每个灰度级的像素个数
  float pixelPro[GrayScale]; //每个灰度级的像素概率
  int16 i, j, pixelSum = width * height;
  uint8 threshold = 0;
  uint8 *data = image; //指向像素数据的指针
  for (i = 0; i < GrayScale; i++)
  {
    pixelCount[i] = 0;
    pixelPro[i] = 0.0;
  }
  //统计灰度级中每个像素在整幅图像中的个数
  int grayTmp = 0;
  uint32 graySum = 0; //灰度值和
  for (i = 0; i < height; i += 2)
  {
    for (j = 0; j < width; j += 2)
    {
      grayTmp = (int)data[i * IMAGE_W + j];
      pixelCount[grayTmp]++; //将像素值作为计数数组的下标
      graySum += grayTmp;    //计算图片总灰度值和
    }
  }
  float grayEverage = (float)graySum / pixelSum; //计算图像平均灰度

  //计算每个像素在整幅图像中的比例
  for (i = 0; i < GrayScale / 2; i++)
  {
    pixelPro[i] = (float)pixelCount[i] / pixelSum;
  }

  //遍历灰度级[0,255]
  float w0, w1, u0tmp, u1tmp, u0, u1, deltaTmp, deltaMax = 0;
  w1 = u1tmp = 0;
  for (i = GrayScale - 1; i >= StartGray; i--) // i作为阈值，从后往前算前景
  {
    w0 += pixelPro[i];        //背景部分每个灰度值的像素点所占比列之和，即背景部分的比例
    u0tmp += i * pixelPro[i]; //背景部分，每个灰度值点的比例*灰度值

    w1 = 1 - w0; //背景
    u1tmp = grayEverage - u1tmp;

    u0 = u0tmp / w0; //背景平均灰度
    u1 = u1tmp / w1; //前景平均灰度

    deltaTmp = w0 * w1 * pow((u0 - u1), 2); //计算方差
    if (deltaTmp > deltaMax)
    {
      deltaMax = deltaTmp;
      threshold = i;
    }
  }
  return threshold;
}
/***********************************************************
 * @brief 大津算法，可对图像特定区域计算阈值
 * @param image 图像地址
 * @param Startwidth 起始图像宽度（范围1~IMAGE_W）
 * @param EndWidth 终止图像宽度（范围1~IMAGE_W）
 * @param StartHeight 起始图像高度（范围1~IMAGE_H）
 * @param EndHeight 终止图像高度（范围1~IMAGE_H）
 * @return 阈值
 ***********************************************************/
static inline uint8 Otsu_threshold(uint8 *image, uint16 StartWidth, uint16 EndWidth, uint16 StartHeight, uint16 EndHeight)
{
#define GrayScale 256
#define StartGray 90
  int pixelCount[GrayScale] = {0};   //像素个数
  float pixelPro[GrayScale] = {0.0}; //像素概率
  int i, j, pixelSum = (EndWidth - StartWidth + 1) * (EndHeight - StartHeight + 1);
  uint8 threshold = 0;
  uint8 *data = image; //指向像素数据的指针
  uint32 graySum = 0;  //灰度值和

  //统计灰度级中每个像素在整幅图像中的个数
  int grayTmp = 0;
  for (i = StartHeight - 1; i < EndHeight; i++)
  {
    for (j = StartWidth - 1; j < EndWidth; j++)
    {
      grayTmp = (int)data[i * IMAGE_W + j];
      pixelCount[grayTmp]++; //将像素值作为计数数组的下标
      graySum += grayTmp;    //计算图片总灰度值和
    }
  }
  float grayEverage = (float)graySum / pixelSum; //计算图像平均灰度

  //计算每个像素在整幅图像中的比例
  for (i = 0; i < GrayScale; i++)
  {
    pixelPro[i] = (float)pixelCount[i] / pixelSum;
  }

  //遍历灰度级[0,255]
  float w0, w1, u0tmp, u1tmp, u0, u1, deltaTmp, deltaMax = 0;
  w1 = u1tmp = 0;
  for (i = GrayScale - 1; i >= StartGray; i--) // i作为阈值，从后往前算前景
  {
    w1 += pixelPro[i]; //前景
    u1tmp += i * pixelPro[i];

    w0 = 1 - w1; //背景
    u0tmp = grayEverage - u1tmp;

    u0 = u0tmp / w0;                        //背景平均灰度
    u1 = u1tmp / w1;                        //前景平均灰度
    deltaTmp = w0 * w1 * pow((u0 - u1), 2); //计算方差
    if (deltaTmp > deltaMax)
    {
      deltaMax = deltaTmp;
      threshold = i;
    }
  }

  return threshold;
}
/***********************************************************
 * @brief 迭代法求阈值
 * @param image 图像地址
 * @param col 图像宽度（范围1~IMAGE_W）
 * @param row 图像高度（范围1~IMAGE_H）
 * @return 阈值
 ***********************************************************/
#define ERROR 2 //误差

int16 EdgeThres = 18; //晚上20  白天25 18

float Iteration_Threshould(uint8 *image, uint16 col_w, uint16 row_h)
{
  uint16_t i = 0, j = 0, N0 = 0, N1 = 0, flag = 0;
  float T0, T1, T2, T_center;
  uint32_t S0 = 0, S1 = 0;
  //初始预估值
  float threshold = 70.0;
  T2 = threshold;

  uint8 *data = image; //指向像素数据的指针
  do
  {
    //分割图像为两部分
    for (i = 0; i < row_h; i++)
    {
      for (j = 0; j < col_w; j++)
      {
        if (image[i * col_w + j] < T2)
        {
          S0 += data[i * col_w + j]; // G2部分的像素灰度值之和
          N0++;                      // G2部分的像素点个数
        }
        else
        {
          S1 += data[i * col_w + j]; // G1部分的像素灰度值之和
          N1++;                      // G1部分的像素点个数
        }
      }
    }
    T0 = S0 / N0;             // G2部分的平均灰度值
    T1 = S1 / N1;             // G1部分的平均灰度值
    T_center = (T0 + T1) / 2; //新的阈值
    if (T2 < T_center)
    {
      if ((T_center - T2) > ERROR)
      {
        flag = 1;
      }
      else
      {
        flag = 0;
      }
    }
    else
    {
      if ((T2 - T_center) > ERROR)
      {
        flag = 1;
      }
      else
      {
        flag = 0;
      }
    }
    T2 = T_center;
    threshold = T2;
  } while (flag);
  return threshold;
}
/***********************************************************
 * @brief 图像直方图均衡化（效果不佳）
 ***********************************************************/
void HistEqImageConvert(uint8 *RawImagePtr, uint8 *HistEqImagePtr)
{
  int gray[256] = {0};                //记录每个灰度级别下的像素个数
  float gray_prob[256] = {0};         //记录灰度分布频率
  float gray_distribution[256] = {0}; //记录原始图像的累计密度
  int gray_equal[256] = {0};          //均衡化后的灰度值
  int gray_sum = 0;                   //像素总数
  gray_sum = IMAGE_H * IMAGE_W;

  //统计每个灰度下的像素个数
  for (int i = 0; i < gray_sum; i++)
  {
    gray[RawImagePtr[i]]++;
  }

  //统计原始图像的灰度分布频率
  for (int i = 0; i < 256; i++)
  {
    gray_prob[i] = (float)gray[i] / gray_sum;
  }
  //计算累计密度
  gray_distribution[0] = gray_prob[0];
  for (int i = 1; i < 256; i++)
  {
    gray_distribution[i] = gray_distribution[i - 1] + gray_prob[i];
  }
  //重新计算均衡化后的灰度值，四舍五入。参考公式：(N-1)*T+0.5
  for (int i = 0; i < 256; i++)
  {
    gray_equal[i] = (uint8)(255 * gray_distribution[i] + 0.5); //(int)(a+0.5)
  }
  //直方图均衡化,更新原图每个点的像素值
  for (int i = 0; i < gray_sum; i++)
  {
    HistEqImagePtr[i] = gray_equal[RawImagePtr[i]];
  }
}
/***********************************************************
 * @brief 求取二值化阈值
 * @param type 0:大津法；1：迭代法；2：阳光算法;3:直方图均衡加大津
 * @param raw_iamge 原始图像起始行地址
 * @return
 ***********************************************************/
static inline void Binary_threshold(uint8 type, uint8 *raw_image)
{
  if (type == 0)
  {
    CarInfo.BinaryThreshold = Otsu_threshold(raw_image, 1, IMAGE_W, 25, IMAGE_H - 10);
  }
  if (type == 1)
  {
    CarInfo.BinaryThreshold = Iteration_Threshould(raw_image, IMAGE_W, IMAGE_H);
  }
  if (type == 2)
  {
    uint8 ImageThreshold1 = Otsu_threshold(raw_image, 1, IMAGE_W, 25, IMAGE_H - 10); //计算第一次阈值
    for (int i = 0; i < IMAGE_H; i++)
      for (int j = 0; j < IMAGE_W; j++)
      {
        if (mt9v03x_csi_image[i][j] > ImageThreshold1)
        {
          BinaryImage[i][j] = mt9v03x_csi_image[i][j];
        }
        else
        {
          BinaryImage[i][j] = ImageThreshold1 - 10;
        }
      }
    uint8 ImageThreshold2 = Otsu_threshold(BinaryImage[0], 1, IMAGE_W, 25, IMAGE_H - 10); //计算第二次阈值
    CarInfo.BinaryThreshold = ImageThreshold2;
  }
  if (type == 3)
  {
    uint8 *HistImagePtr = hist_eq_image[0];
    HistEqImageConvert(raw_image, HistImagePtr);
    CarInfo.BinaryThreshold = Otsu_threshold(HistImagePtr, 1, IMAGE_W, 25, IMAGE_H - 10);
  }
	if (type == 4)
  {
    CarInfo.BinaryThreshold = 228;
  }
}
/***********************************************************
 * @brief 二值化更新
 * @param type 二值化方法
 * @return
 ***********************************************************/
void Binary_renew(uint8 type)
{
  Image_Compensate(mt9v03x_csi_image[0], LightImage[0]); //光补偿
  Binary_threshold(type, LightImage[0]);
}
/***********************************************************
 * @brief 二值化图像
 * @param
 * @return
 ***********************************************************/
void Binary_image(void)
{
	float n = 0;
  for (int i = 0; i < IMAGE_H; i++)
    for (int j = 0; j < IMAGE_W; j++)
    {
      if (mt9v03x_csi_image[i][j] > CarInfo.BinaryThreshold)
      {
        BinaryImage[i][j] = White;
				n++;
      }
      else
      {
        BinaryImage[i][j] = Black;
      }
    }
	n = n / (IMAGE_H * IMAGE_H);
	CarInfo.white_proportion = n * 100;
}
/***********************************************************
 * @brief 3x3腐蚀
 * @param p 二值化数组
 * @param p1 滤波后数组
 * @return
 ***********************************************************/
void erode3(uint8 (*p)[IMAGE_W], uint8 (*p1)[IMAGE_W])
{
	int min_value;
	for (int y = 1; y < 118; y++)
	{
		for (int x = 1; x < 186; x++)
		{
			min_value = 255;
			for(int dy = -1; dy <= 1; dy++)
			{
				for(int dx = -1; dx <= 1; dx++)
				{
					if (p[y + dy][x + dx] < min_value)
						min_value = p[y + dy][x + dx];
				}
			}
			p1[y][x] = min_value;
		}
	}
}
/***********************************************************
 * @brief 3x3膨胀
 * @param p 二值化数组
 * @param p1 滤波后数组
 * @return
 ***********************************************************/
void dilate3(uint8 (*p)[IMAGE_W], uint8 (*p1)[IMAGE_W])
{
	int max_value;
	for (int y = 1; y < 118; y++)
	{
		for (int x = 1; x < 186; x++)
		{
			max_value = 0;
			for(int dy = -1; dy <= 1; dy++)
			{
				for(int dx = -1; dx <= 1; dx++)
				{
					if (p[y + dy][x + dx] > max_value)
						max_value = p[y + dy][x + dx];
				}
			}
			p1[y][x] = max_value;
		}
	}
}
/***********************************************************
 * @brief 3x3开运算
 * @param p 二值化数组
 * @param p1 滤波后数组
 * @return
 ***********************************************************/
void opening(uint8 (*p)[IMAGE_W], uint8 (*p1)[IMAGE_W])
{
	for (int y = 1; y < 118; y++)
	{
		for (int x = 1; x < 186; x++)
		{
			int n = 0;
			if(p[y][x] == Black)
			{
				for(int dy = -1; dy <= 1; dy++)
				{
					for(int dx = -1; dx <= 1; dx++)
					{
						if (p[y + dy][x + dx] == White)
							n++;
					}
				}
				if(n > 2)
					p1[y][x] = White;
			}		
		}
	}
}
/*************************************************************
 * @brief 八领域
 * @param p 二值化数组指针
 * @param raw 数组的行
 * @param col 数组的列
 * @return 是否邻域全白
 *************************************************************/
static inline int eight_areas(uint8 (*p)[188], int raw, int col)
{
  int flag = 0; //顺时针查找标志位
  if (raw < 119 && raw > 0 && col < 187 && col > 0)
  {
    //该点的八领域全是白点
    if (p[raw - 1][col - 1] == White && p[raw - 1][col] == White && p[raw - 1][col + 1] == White && p[raw][col - 1] == White && p[raw][col + 1] == White && p[raw + 1][col - 1] == White && p[raw + 1][col] == White && p[raw + 1][col + 1] == White)
      flag = 1;
    else
      flag = 0;
  }
  else
    flag = 0;
  return flag;
}
/*************************************************************
 * @brief 寻找定点
 *
 * @return 带回定点的信息
 *************************************************************/
uint8 seedpoint[2][2]; //种子点信息
static inline void find_seedpoint(uint8 (*p)[IMAGE_W])
{
  int Flag = 0;   //找到顶点标志
  uint8 *row_pic; //保存单行图片
  int j, i;
  for (j = 119; j > 0; j--)
  {
    row_pic = p[j];
    for (i = 1; i < 187; i++)
    {
      if (*(row_pic + i) == White && *(row_pic + i - 1) == Black) //找到左点(黑白)
      {
        seedpoint[0][0] = i; //左边种子点横坐标
        seedpoint[0][1] = j; //左边种子点纵坐标
        Flag += 1;
				break;
      }
    }
    if (Flag == 1)
    {
      break;
    }
  }
	for (j = 0; j < 119; j++)
	{
		row_pic = p[j];
		for(i = 187; i > 0; i--)
		{
			if (*(row_pic + i) == Black && *(row_pic + i - 1) == White) //找到右点(白黑)
      {
        seedpoint[1][0] = i; //右边种子点横坐标
        seedpoint[1][1] = j; //右边种子点纵坐标
        Flag += 1;
				break;
      }
		}
		if(Flag == 2)
			break;
	}
}
/*************************************************************
 * @brief 寻找底边中点
 *
 * @return 带回底边中点信息
 *************************************************************/
uint8 trackpoint[2]; //中点信息
void find_trackpoint()
{
  find_seedpoint(erode_image);
	trackpoint[0] = (seedpoint[0][0] + seedpoint[1][0]) / 2;
	trackpoint[1] = (seedpoint[0][1] + seedpoint[1][1]) / 2;
}
/*************************************************************
 * @brief 寻找图像质心中点
 *
 * @return 带回底边中点信息
 *************************************************************/
uint8 barycentre[2];
void find_barycen(uint8 (*img)[IMAGE_W])
{
	int x = 0,y = 0,n = 0;
	for(int j = 0; j<119; j++)
	{
		for(int i = 0; i<187; i++)
		{
			if(img[j][i] == White)
			{
				x += i;
				y += j;
				n++;
			}
		}
	}
	x /= n;
	y /= n;
	barycentre[0] = x;
	barycentre[1] = y;
}
/*************************************************************
 * @brief 寻找图片的定位点
 * @param p 图片二值化数组
 * @return 带回底边中点信息
 *************************************************************/
void locating_point(uint8 (*p)[IMAGE_W])
{
	uint8 right[120] = {0};
	uint8 left[120] = {0};
	for (int j = 119; j > 0; j--)
	{
		for (int i = 0; i < 185; i++)
		{
			if(p[j][i] == Black && p[j][i + 1] == White && p[j][i + 2] == White)//黑白白判断为左边
			{
				left[j] = i + 1;
			}
			if(p[j][i] == White && p[j][i + 1] == Black && p[j][i + 2] == Black)//白黑黑判断为右边
			{
				right[j] = i + 1;
			}
		}
	}
}
/*************************************************************
 * @brief 计算当前车与图片存在的角度
 * @param p 图片二值化数组
 * @return 计算最小角度
 *************************************************************/
double Computing_angle(uint8 (*p)[IMAGE_W])
{
  int i, j;
  int flag, flag1, flag2 = 0;
  double angle; //角度偏差
  uint8 border[120];
  for (i = 0; i < 120; i++)
  {
    border[i] = 0;
  }
  //找顶点
  for (j = 118; j > 0; j--)
  {
    for (i = 1; i < 187; i++)
    {
      if (p[j][i] == White) //找到一个白点
      {
        //八领域判断直角顶点
        if (p[j - 1][i - 1] == Black && p[j - 1][i] == White && p[j - 1][i + 1] == White && p[j][i - 1] == Black && p[j][i + 1] == White && p[j + 1][i - 1] == Black && p[j + 1][i] == Black && p[j + 1][i + 1] == Black)
        {
//          angle_dot[0] = i;
//          angle_dot[1] = j;
          angle = 90.0;
          return angle;
        }
        else //不是直角点作为种子点
        {
          Xsite = i;
          Ysite = j;
          flag = 1;
          break;
        }
      }
    }
    if (flag == 1)
    {
      break;
    }
  }
  for (j = Ysite; j > 0; j--)
  {
    if (p[j][Xsite] == White)
    {
      for (i = Xsite; i < 187; i++)
      {
        if (p[j][i] == White && p[j][i + 1] == Black) //黑白跳变判断为边
        {
          border[j] = i;
          Xsite = i;
          break;
        }
      }
    }
  }
  for (i = 119; i > 0; i--)
  {
    if (border[i] != 0) //找到边开始的行
    {
      flag1 = i; //记录该行
      break;
    }
  }
  for (i = flag1; i > flag1 - 20; i--) //边的长度最长为20
  {
    if (border[i] == 0)
    {
      flag2 = i - 1;
      break;
    }
  }
//  if (flag2 == 0)
//  {
//    angle = atan2(20, border[flag1 - 20] - angle_dot[0]) * 180 / 3.14;
//  }
//  else if (flag2 != 0)
//  {
//    angle = atan2(flag1 - flag2, border[flag2] - angle_dot[0]) * 180 / 3.14;
//  }
  return angle;
}
/*************************************************************
* 前进方向定义：
 *   0
 * 3   1
 *   2
 *************************************************************/
const int dir_front[4][2] = {{0,  -1},
                             {1,  0},
                             {0,  1},
                             {-1, 0}};
const int dir_frontleft[4][2] = {{-1, -1},
                                 {1,  -1},
                                 {1,   1},
                                 {-1,  1}};
const int dir_frontright[4][2] = {{1,  -1},
                                  {1,  1},
                                  {-1, 1},
                                  {-1, -1}};
/*************************************************************
 * @brief 左手迷宫巡线
 * @param uint8 (*img)[IMAGE_W]:存放图像相关数据的指针。
 * @param block_size:自适应阈值的范围。
 * @param clip_value:经验值，防止出现强制分割的现象（一般为2~5）。
 * @param x:种子x坐标。
 * @param y:种子y坐标。
 * @param int pts[ ][2]用来存放边线数据。
 * @param int *num:存放边线像素点的个数。
 * @return 
 *************************************************************/
void findline_lefthand(uint8 (*img)[IMAGE_W], int block_size, int clip_value, int x, int y, int pts[][2], int *num)
{
	int half = block_size / 2;
  int step = 0, dir = 0, turn = 0;
	 while (step < *num && half < x && x < IMAGE_W - half - 1 && half < y && y < IMAGE_H - half - 1 && turn < 4)
	 {
		 int local_thres = 0;
		 for (int dy = -half; dy <= half; dy++)
		 {
			 for (int dx = -half; dx <= half; dx++)
			 {
				 local_thres += PV(img, x + dx, y + dy);
			 }
		 }
		 local_thres /= block_size * block_size;
     local_thres -= clip_value;
		 
		 int current_value = PV(img, x, y);
     int front_value = PV(img, x + dir_front[dir][0], y + dir_front[dir][1]);
     int frontleft_value = PV(img, x + dir_frontleft[dir][0], y + dir_frontleft[dir][1]);
		 if (front_value < local_thres) 
			{
				dir = (dir + 1) % 4;
				turn++;
      }
			else if (frontleft_value < local_thres) 
			{
        x += dir_front[dir][0];
        y += dir_front[dir][1];
        pts[step][0] = x;
        pts[step][1] = y;
        step++;
        turn = 0;
      }
			else 
			{
         x += dir_frontleft[dir][0];
         y += dir_frontleft[dir][1];
         dir = (dir + 3) % 4;
         pts[step][0] = x;
         pts[step][1] = y;
         step++;
         turn = 0;
		  }
	 }
	 *num = step;
}
/*************************************************************
 * @brief 右手迷宫巡线
 * @param uint8 (*img)[IMAGE_W]:存放图像相关数据的指针。
 * @param block_size:自适应阈值的范围。
 * @param clip_value:经验值，防止出现强制分割的现象（一般为2~5）。
 * @param x:种子x坐标。
 * @param y:种子y坐标。
 * @param int pts[ ][2]用来存放边线数据。
 * @param int *num:存放边线像素点的个数。
 * @return 
 *************************************************************/
void findline_righthand(uint8 (*img)[IMAGE_W], int block_size, int clip_value, int x, int y, int pts[][2], int *num)
{
	int half = block_size / 2;
  int step = 0, dir = 0, turn = 0;
	 while (step < *num && half < x && x < IMAGE_W - half - 1 && half < y && y < IMAGE_H - half - 1 && turn < 4)
	 {
		 int local_thres = 0;
		 for (int dy = -half; dy <= half; dy++)
		 {
			 for (int dx = -half; dx <= half; dx++)
			 {
				 local_thres += PV(img, x + dx, y + dy);
			 }
		 }
		 local_thres /= block_size * block_size;
     local_thres -= clip_value;
		 
		 int current_value = PV(img, x, y);
     int front_value = PV(img, x + dir_front[dir][0], y + dir_front[dir][1]);
     int frontright_value = PV(img, x + dir_frontright[dir][0], y + dir_frontright[dir][1]);
		 if (front_value < local_thres) 
			{
				dir = (dir + 1) % 4;
				turn++;
      }
			else if (frontright_value < local_thres) 
			{
        x += dir_front[dir][0];
        y += dir_front[dir][1];
        pts[step][0] = x;
        pts[step][1] = y;
        step++;
        turn = 0;
      }
			else 
			{
         x += dir_frontright[dir][0];
         y += dir_frontright[dir][1];
         dir = (dir + 3) % 4;
         pts[step][0] = x;
         pts[step][1] = y;
         step++;
         turn = 0;
		  }
	 }
	 *num = step;
	
}